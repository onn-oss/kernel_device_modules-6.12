## drivers/device_info/Kconfig
```kconfig
# SPDX-License-Identifier: GPL-2.0
config T_PRODUCT_INFO
    tristate "T_PRODUCT_INFO"
```

## drivers/misc/mediatek/flashlight/v4l2/Kconfig
```kconfig
config MTK_VIDEO_LM3643
	tristate "LM3643 dual flash driver support"
	depends on I2C && VIDEO_DEV && MEDIA_CONTROLLER
	depends on MEDIA_CAMERA_SUPPORT
	select REGMAP_I2C
	help
	  This is a driver for the lm3643 dual flash controllers. It controls
	  flash, torch LEDs.

	  Say Y here if you want a flashlight driver IC LM3643.
	  Select this only if your board has this IC.
	  Say M here if you want to compile this driver as a module.

config MTK_VIDEO_LM3644
	tristate "LM3644 dual flash driver support"
	depends on I2C && VIDEO_DEV && MEDIA_CONTROLLER
	depends on MEDIA_CAMERA_SUPPORT
	select REGMAP_I2C
	help
	  This is a driver for the lm3644 dual flash controllers. It controls
	  flash, torch LEDs.

	  Say Y here if you want a flashlight driver IC LM3644.
	  Select this only if your board has this IC.
	  Say M here if you want to compile this driver as a module.

config MTK_VIDEO_SY7806
	tristate "SY7806 dual flash driver support"
	depends on I2C && VIDEO_DEV && MEDIA_CONTROLLER
	depends on MEDIA_CAMERA_SUPPORT
	select REGMAP_I2C
	help
	  This is a driver for the sy7806 dual flash controllers. It controls
	  flash, torch LEDs.

	  Say Y here if you want a flashlight driver IC SY7806.
	  Select this only if your board has this IC.
	  Say M here if you want to compile this driver as a module.

config MTK_FLASHLIGHT_OCP81378
	tristate "Mediatek flashlight with driver IC (OCS OCP81378)"
	depends on MTK_FLASHLIGHT
	help
	  This is for the flashlight driver IC (OCS OCP81378).

	  Say Y here if you want a flashlight driver IC OCP81378.
	  Select this only if your board has this IC.

	  Say M here if you want to compile this driver as a module.

config FLASHLIGHT_DEBUG
	bool "debug version build variant for flashlight driver"
	default n
	  help
	  This is used for flashlight driver to distinguishing user load and
	  eng/userdebug load.
	  Say Y if this is eng/userdebug load.
	  If not, say N.
```

## oem/tinno_charger/Kconfig
```kconfig
config OEM_TINNO_CHARGER
	tristate "oem tinno charger"
	default n
	help
	  support oem_tinno_charger

config OEM_SWITCH_CHARGER
	tristate "oem third party switch charger support"
	depends on OEM_TINNO_CHARGER
	default n
	help
	  support oem_switch_charger

config OEM_SWITCH_CHARGER_SC8960X
	tristate "oem switch charger sc8960x"
	depends on OEM_SWITCH_CHARGER
	default n
	help
	  support oem_switch_charger_sc8960x

config OEM_SWITCH_CHARGER_CX2560X
	tristate "oem switch charger cx2560x"
	depends on OEM_SWITCH_CHARGER
	default n
	help
	  support oem_switch_charger_cx2560x

config OEM_TCPC
	tristate "oem third party cc logic support"
	default n
	help
	  support oem_tcpc

config OEM_TCPC_PD_UPM7610
	tristate "oem tcpc pd upm7610"
	depends on OEM_TCPC
	default n
	help
	  support oem_tcpc_pd_upm7610

config OEM_TCPC_PD_AW35615
	tristate "oem tcpc pd aw35615"
	depends on OEM_TCPC
	default n
	help
	  support oem_tcpc_pd_aw35615
```

## oem/tinno_tp/Kconfig
```kconfig
# SPDX-License-Identifier: GPL-2.0-only
#
# Touchscreen driver configuration (mgk_64_k612_defconfig)
#
config TINNO_TOUCHSCREEN_PEN
	tristate "Focaltech Touchscreen"
	default N
	help
	  Say Y here if you have Focaltech touch panel.
	  If unsure, say N.
```
